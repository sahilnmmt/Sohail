## firmware/main/Kconfig.projbuild
```kconfig
menu "Sohail robot"

    config SOHAIL_DEVICE_NAME
        string "Display name sent with messages"
        default "Sohail"
        help
            Shown on the other robots as the sender (max 16 bytes).

    config SOHAIL_GROUP_ID
        string "Group id"
        default "family"
        help
            Robots in the same group receive each other's nudges and
            reactions. Letters, digits, '-' and '_' only.

    menu "MQTT broker"
        config SOHAIL_MQTT_URI
            string "Broker URI"
            default "mqtt://192.168.1.10:1883"
            help
                mqtt://host:1883 for a broker on your LAN (see server/), or
                mqtts://host:8883 for a TLS broker with a public certificate.

        config SOHAIL_MQTT_USERNAME
            string "Username (empty for none)"
            default ""

        config SOHAIL_MQTT_PASSWORD
            string "Password"
            default ""
    endmenu

    menu "Display (ST7789, SPI)"
        config SOHAIL_LCD_WIDTH
            int "Width"
            default 240
        config SOHAIL_LCD_HEIGHT
            int "Height"
            default 280
        config SOHAIL_LCD_X_GAP
            int "X offset in controller RAM"
            default 0
        config SOHAIL_LCD_Y_GAP
            int "Y offset in controller RAM"
            default 20
            help
                1.69" 240x280 modules use 20; 1.3"/1.54" 240x240 modules use 0.
        config SOHAIL_LCD_INVERT
            bool "Invert colours (most IPS panels need this)"
            default y
        config SOHAIL_LCD_BGR
            bool "Panel uses BGR element order"
            default n
        config SOHAIL_LCD_PCLK_MHZ
            int "SPI clock (MHz)"
            range 10 80
            default 40
        config SOHAIL_PIN_LCD_SCLK
            int "SCLK GPIO"
            default 12
        config SOHAIL_PIN_LCD_MOSI
            int "MOSI GPIO"
            default 11
        config SOHAIL_PIN_LCD_CS
            int "CS GPIO"
            default 10
        config SOHAIL_PIN_LCD_DC
            int "DC GPIO"
            default 9
        config SOHAIL_PIN_LCD_RST
            int "RST GPIO (-1 if not connected)"
            default 14
        config SOHAIL_PIN_LCD_BL
            int "Backlight GPIO (-1 if always on)"
            default 13
    endmenu

    menu "Audio (I2S amplifier, e.g. MAX98357A)"
        config SOHAIL_AUDIO_ENABLE
            bool "Enable speaker"
            default y
        config SOHAIL_PIN_I2S_BCLK
            int "BCLK GPIO"
            default 15
            depends on SOHAIL_AUDIO_ENABLE
        config SOHAIL_PIN_I2S_WS
            int "LRCLK / WS GPIO"
            default 16
            depends on SOHAIL_AUDIO_ENABLE
        config SOHAIL_PIN_I2S_DOUT
            int "DIN (data to amp) GPIO"
            default 17
            depends on SOHAIL_AUDIO_ENABLE
        config SOHAIL_AUDIO_VOLUME
            int "Volume (0-100)"
            range 0 100
            default 60
            depends on SOHAIL_AUDIO_ENABLE
    endmenu

    menu "Input"
        config SOHAIL_PIN_BUTTON
            int "Button GPIO (active low)"
            default 0
            help
                GPIO0 is the BOOT button on most ESP32-S3 dev boards.
        config SOHAIL_TOUCH_ENABLE
            bool "Capacitive touch pad on the head"
            default n
            help
                Leave off unless a touch electrode is wired up; a floating
                pad can trigger by itself.
        config SOHAIL_TOUCH_PAD
            int "Touch channel (TOUCH_PAD_NUMx, GPIOx on the S3)"
            range 1 14
            default 4
            depends on SOHAIL_TOUCH_ENABLE
        config SOHAIL_TOUCH_THRESHOLD_PCT
            int "Touch threshold (% above baseline)"
            range 1 50
            default 3
            depends on SOHAIL_TOUCH_ENABLE
    endmenu

endmenu
```
